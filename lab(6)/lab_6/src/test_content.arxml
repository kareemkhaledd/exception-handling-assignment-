AUTOSAR XML
3 x :
  ContainerB  # A
  ContainerA  # B
  ContainerC
